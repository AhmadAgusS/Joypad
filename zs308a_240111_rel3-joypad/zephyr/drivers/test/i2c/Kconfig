## zs308a_240111_rel3-joypad/zephyr/drivers/test/i2c/Kconfig
```kconfig
# drivers configuration options

# Copyright (c) 2015 Intel Corporation
# SPDX-License-Identifier: Apache-2.0

config TEST_I2C_MASTER
	bool "Enable Asynchronous call support"
	default n
	help
	  This option enable i2c master test.

config TEST_MASTER_AT_I2C_DEV
	string "Which I2C dev you would like to test i2c master on"
	default "I2C_0"
	help
	  This option assign which I2C to test with

config TEST_I2C_SLAVE
	bool "Enable Asynchronous call support"
	default n
	help
	  This option enable i2c slave test.

config TEST_SLAVE_AT_I2C_DEV
	string "Which I2C dev you would like to test i2c slave on"
	default "I2C_1"
	help
	  This option assign which I2C to test with

config TEST_I2C_SLAVE_ADDR
	hex
	prompt "USB HID device interrupt out endpoint address"
	default 0x60
	range 0x00 0xff
	help
		This option assign slave address when you enable test/i2c_slave.c
```

## zs308a_240111_rel3-joypad/zephyr/drivers/test/uart/Kconfig
```kconfig
# drivers configuration options

# Copyright (c) 2015 Intel Corporation
# SPDX-License-Identifier: Apache-2.0

config TEST_UART
	bool "Enable UART test call support"
	default n
	help
	  This option enable uart test.
```

## zs308a_240111_rel3-joypad/zephyr/framework/sensor/sensor_algo/Kconfig
```kconfig
# Configuration options for Actions Sensor

# Copyright (c) 2020 Actions Technology Co., Ltd
# SPDX-License-Identifier: Apache-2.0

menuconfig SENSOR_ALGO
	bool "Sensor algorithm"
	help
	  Enable Sensor algorithm

if SENSOR_ALGO

config SENSOR_ALGO_HR_GH30X
	bool "GH30X heart-rate algorithm"
	default n
	help
	  Enable GH30X heart-rate algorithm

config SENSOR_ALGO_HR_VCARE
	bool "VCARE heart-rate algorithm"
	default n
	help
	  Enable VCARE heart-rate algorithm

config SENSOR_ALGO_HR_HX3605
	bool "HX3605 heart-rate algorithm"
	default n
	help
	  Enable HX3605 heart-rate algorithm
	  
config SENSOR_ALGO_HR_HX3690
	bool "HX3690 heart-rate algorithm"
	default n
	help
	  Enable HX3690 heart-rate algorithm
	  
config SENSOR_ALGO_MOTION_CYWEE
	bool "Cywee motion algorithm"
	default n
	help
	  Enable Cywee motion algorithm

config SENSOR_ALGO_MOTION_CYWEE_DML
	bool "Cywee motion algorithm DML"
	default n
	help
	  Enable Cywee motion algorithm DML

config SENSOR_ALGO_MOTION_SILAN
	bool "Silan motion algorithm"
	default n
	help
	  Enable Silan motion algorithm

config HR_ROM_BASE
	hex
	default 0x10001000 if SOC_LARK
	help
	  Sensor rom base address for sensor algorithm

config SENSOR_ROM_BASE
	hex
	default 0x10020000 if SOC_LARK
	help
	  Sensor rom base address for sensor algorithm

config SENSOR_SLEEP_ROM_BASE
	hex
#	default 0x1003a000 if SOC_LARK
	help
	  Sensor rom base address for sensor algorithm

config SENSOR_RAM_CODE_SIZE
	hex "Sensor ram code size"
	default 0x3000
	help
	  Sensor ram code size for sensor algorithm

endif # SENSOR_ALGO
```

## zs308a_240111_rel3-joypad/zephyr/samples/bluetooth/spp_thruput/boards/ats3085_dvb_watch.conf
```kconfig
CONFIG_DSP_IMAGE_PATH="/NAND:K/"

CONFIG_UI_MEM_BLOCK_SIZE=412232
#CONFIG_GUI_TEXT_IMG_CACHE_SIZE=1200000

#usb mass storage config
CONFIG_MASS_STORAGE_DISK_PDRV=1
CONFIG_MASS_STORAGE_DISK_NAME="NAND"

#psram config
CONFIG_PSRAM_SIZE=8192

CONFIG_SPINAND_ACTS=y
CONFIG_SPINAND_LIB=y

CONFIG_DISK_ACCESS_SPINAND=y
```

## zs308a_240111_rel3-joypad/zephyr/samples/ota_usbhid/src/ota/Kconfig
```kconfig
menuconfig OTA_APP
	bool
	prompt "OTA App Support"
	select OTA_UPGRADE
	select STREAM
	default n
	help
	This option enable or disable ota app

config OTA_FOREGROUND
	bool "OTA Foreground Support"
	depends on OTA_APP
	default y
	help
	  This option enable OTA foreground upgrade.

config OTA_UPGRADE
	bool "OTA Upgrade Support"
	default n
	select PARTITION
	select FIRMWARE_VERSION
	help
	  This option enable OTA upgrade.

if OTA_UPGRADE
config OTA_RECOVERY
	bool "OTA recovery firmware Support"
	default n
	depends on OTA_UPGRADE
	help
	  This option enable OTA recovery firmware.

config OTA_RECOVERY_APP
	bool "OTA recovery application Support"
	default n
	depends on OTA_RECOVERY
	help
	  This option enable OTA recovery application.

config OTA_TEMP_PART_DEV_NAME
	string "OTA temp partition device name"
	depends on OTA_RECOVERY
	default "xspi_nor"
	help
	  Specify the device name for temp partition.

config XSPI1_NOR_ACTS_DEV_NAME
	string "SPI1 NOR flash device name"
	depends on XSPI_NOR_ACTS
	default "spi1_nor"
	help
	  Specify the device name for SPI1 NOR flash driver.

config OTA_BACKEND_TEMP_PART
    bool "OTA upgrade by spinor Support"
    select FLASH
    default n
    help
      This option enables OTA upgrade by spinor.

config OTA_BACKEND_USBHID
	bool "OTA upgrade by USBHID host Support"
	select STREAM
	default n
	help
        This option enables OTA upgrade by USBHID.

config OTA_ERASE_FACTORY_RW_NVRAM
	bool "OTA upgrade erase factory rw nvram"
	default n
	help
        This option enables OTA upgrade erase factory rw nvram.

endif
```

## zs308a_240111_rel3-joypad/zephyr/soc/arm/actions/lark/Kconfig.soc
```kconfig
# Copyright (c) 2016 Linaro Limited.
# SPDX-License-Identifier: Apache-2.0

choice
	prompt "LARK MCU Selection"
	depends on SOC_SERIES_LARK

config SOC_LARK
	bool "LARK"

endchoice

if SOC_LARK

config SOC_SPI0_USE_CK64M
	bool
	prompt "enable cpu spi0 to use CK64M clock source"
	default y
	help
		enable cpu spi0 to use CK64M clock source

config IRQ_VECTOR_IN_SRAM
	bool
	prompt "enable irq vector copy to sram"
	default n
	help
		enable irq vector copy to sram

config SLEEP_FUNC_IN_SRAM
	bool
	prompt "enable sleep func copy to sram"
	default y
	help
		enable sleep func copy to sram

config SOC_WKEN_BAT
	bool
	prompt "eanbel battery first conected to run system"
	default n
	help
		the battery is connected for the first time;if disable, battery first insert,system power off.

config ACTS_POWERPATH_CHARGER
	bool
	prompt "External charger and path power management"
	default n
	depends on !SOC_WKEN_BAT
	help
		is used to determine the conditions for shutting down the system after the battery is inserted.


config SOC_EP_MODE
	bool
	prompt "indicate ep mode"
	default n
	help
		prompt "indicate ep mode

config SOC_NO_PSRAM
	bool
	prompt "indicate soc not integrate psram"
	default n
	help
		prompt  "indicate soc not integrate psram"

config SLEEP_SENSOR_RUN_ON_NOR
	bool
	prompt "enable sleep sensor algo run on NOR"
	default n
	help
		enable sleep sensor algo run on NOR

config SLEEP_TIMER_DEBUG
	bool
	prompt "enable sleep timestamp debug"
	default n
	help
		enable sleep timestamp debug

config SLEEP_UART_SILENT
	bool
	prompt "enable sleep uart silent"
	default n
	help
		enable sleep uart silent

config SLEEP_COPY_SRAM_FOR_SENSOR
	bool
	prompt "enable copy sram for sensor algo"
	default n
	help
		enable copy sram for sensor algo

config SLEEP_MEMORY_CHECK_INTEGRITY
	bool
	prompt "enable memory check integrity"
	default n
	help
		enable memory check integrity

config SLEEP_DISABLE_BT
	bool
	prompt "disable Bluetooth when deep sleep"
	default n
	help
		disable Bluetooth when deep sleep

endif
```

## zs308a_240111_rel3-joypad/zephyr/west.yml
```yaml
manifest:
  projects:
  - name: cmsis
    url: ssh://192.168.4.4:29418/ZH/actions/ZSDK_HAL_CMSIS
    revision: REL3__TAG_ZS308A_2700_220919_BF3
    path: thirdparty/hal/cmsis
  - name: fatfs
    url: ssh://192.168.4.4:29418/ZH/actions/ZSDK_FS_FATFS
    revision: REL3__TAG_ZS308A_2700_220919_BF3
    path: thirdparty/fs/fatfs
  - name: lvgl
    url: ssh://192.168.4.4:29418/ZH/actions/ZSDK_LIB_LVGL
    revision: REL3__TAG_ZS308A_2700_220919_BF3
    path: thirdparty/lib/gui/lvgl
  - name: alipay
    url: ssh://192.168.4.4:29418/ZH/actions/ZSDK_LIB_ALIPAY
    revision: REL3__TAG_ZS308A_2700_220919_BF3
    path: thirdparty/lib/alipay
  - name: alipay_wxpay
    url: ssh://192.168.4.4:29418/ZH/actions/ZSDK_LIB_ALIPAY_WXPAY
    revision: REL3__TAG_ZS308A_2700_220919_BF3
    path: thirdparty/lib/alipay_wxpay
  - name: mbedtls
    url: ssh://192.168.4.4:29418/ZH/actions/ZSDK_CRYPTO_MBEDTLS
    revision: REL3__TAG_ZS308A_2700_220919_BF3
    path: thirdparty/crypto/mbedtls
  - name: segger
    url: ssh://192.168.4.4:29418/ZH/actions/ZSDK_DBG_SEGGER
    revision: REL3__TAG_ZS308A_2700_220919_BF3
    path: thirdparty/debug/segger
  - name: tinycrypt
    url: ssh://192.168.4.4:29418/ZH/actions/ZSDK_CRYPTO_TINYCRYPT
    revision: REL3__TAG_ZS308A_2700_220919_BF3
    path: thirdparty/crypto/tinycrypt
  - name: littlefs
    url: ssh://192.168.4.4:29418/ZH/actions/ZSDK_FS_LITTLEFS
    revision: REL3__TAG_ZS308A_2700_220919_BF3
    path: thirdparty/fs/littlefs
  - name: bootloader
    url: ssh://192.168.4.4:29418/ZH/actions/ZSDK_BOOT_LOADER
    revision: REL3__TAG_ZS308A_2700_220919_BF3
  - name: framework_base
    url: ssh://192.168.4.4:29418/ZH/actions/ZSDK_LIB_FRAMEWORK_BASE
    revision: REL3__TAG_ZS308A_2700_220919_BF3
    path: framework/base
  - name: framework_system
    url: ssh://192.168.4.4:29418/ZH/actions/ZSDK_LIB_SYSTEM
    revision: REL3__TAG_ZS308A_2700_220919_BF3
    path: framework/system
  - name: audio
    url: ssh://192.168.4.4:29418/ZH/actions/ZSDK_LIB_AUDIO
    revision: REL3__TAG_ZS308A_2700_220919_BF3
    path: framework/audio
  - name: media
    url: ssh://192.168.4.4:29418/ZH/actions/ZSDK_LIB_MEDIA_BASE
    revision: REL3__TAG_ZS308A_2700_220919_BF3
    path: framework/media
  - name: ota
    url: ssh://192.168.4.4:29418/ZH/actions/ZSDK_LIB_OTA
    revision: REL3__TAG_ZS308A_2700_220919_BF3
    path: framework/ota
  - name: bluetooth
    url: ssh://192.168.4.4:29418/ZH/actions/ZSDK_LIB_BLUETOOTH
    revision: REL3__TAG_ZS308A_2700_220919_BF3
    path: framework/bluetooth
  - name: display
    url: ssh://192.168.4.4:29418/ZH/actions/ZSDK_LIB_DISPLAY
    revision: REL3__TAG_ZS308A_2700_220919_BF3
    path: framework/display
  - name: usb
    url: ssh://192.168.4.4:29418/ZH/actions/ZSDK_LIB_USB
    revision: REL3__TAG_ZS308A_2700_220919_BF3
    path: framework/usb
  - name: sensor
    url: ssh://192.168.4.4:29418/ZH/actions/ZSDK_LIB_SENSOR
    revision: REL3__TAG_ZS308A_2700_220919_BF3
    path: framework/sensor
  - name: bt_watch
    url: ssh://192.168.4.4:29418/ZH/actions/ZSDK_APPLICATION_BT_WATCH
    revision: REL3__TAG_ZS308A_2700_220919_BF3
    path: application/bt_watch
  - name: bt_watch_call
    url: ssh://192.168.4.4:29418/ZH/actions/BT_WATCH_CALL
    revision: REL3__TAG_ZS308A_2700_220919_BF3
    path: application/bt_watch_call
  - name: bt_watch_no_psram
    url: ssh://192.168.4.4:29418/ZH/actions/BT_WATCH_NO_PSRAM
    revision: REL3__TAG_ZS308A_2700_220919_BF3
    path: application/bt_watch_no_psram
  - name: view_demo
    url: ssh://192.168.4.4:29418/ZH/actions/ZSDK_APPLICATION_VIEW_DEMO
    revision: REL3__TAG_ZS308A_2700_220919_BF3
    path: application/view_demo
  self:
    path: zephyr
    west-commands: scripts/west-commands.yml
```
