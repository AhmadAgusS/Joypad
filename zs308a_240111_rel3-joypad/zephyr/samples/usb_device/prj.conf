## CMakeLists.txt
```
# SPDX-License-Identifier: Apache-2.0

cmake_minimum_required(VERSION 3.13.1)

find_package(Zephyr REQUIRED HINTS $ENV{ZEPHYR_BASE})
project(usb_device)

add_subdirectory(src)

target_sources(app PRIVATE src/system_app_main.c)
```

## prj.conf
```kconfig
CONFIG_INPUT_DEV_ACTS_TP_KEY=n
CONFIG_ACTIONS_FRAMEWORK=y

#USB device general config
CONFIG_USB_DEVICE=y
CONFIG_USB_AOTG_OTG=y
CONFIG_USB_AOTG_OTG_VERSION=0x551A22CF
CONFIG_USB_AOTG_DC_ENABLED=y
CONFIG_USB_DEVICE_DRIVER=y
CONFIG_USB_DEVICE_STACK=y
CONFIG_SYS_LOG_USB_OTG_DRIVER_LEVEL=2
CONFIG_SYS_LOG_USB_DEVICE_LEVEL=2
CONFIG_USB_DEVICE_STRING_DESC_MAX_LEN=40
CONFIG_USB_AOTG_UDC_DMA=n
CONFIG_MASS_STORAGE_SWITCH_TO_ADFU=n

#usb controller speed-mode select
CONFIG_USB_AOTG_DC_FS=y

#usb composite device(HID+UAC)config
#CONFIG_USB_AUDIO_CLASS=y
#CONFIG_USB_DEVICE_HID=y
#CONFIG_SYS_LOG_USB_HID_LEVEL=2
#CONFIG_SYS_LOG_USB_SOURCESINK_LEVEL=2
#CONFIG_HID_INTERRUPT_OUT=y
#CONFIG_USB_SELF_DEFINED_REPORT=y
#CONFIG_USB_HID_DEVICE_IF_NUM=0
#CONFIG_USB_AUDIO_DEVICE_IF_NUM=1
#CONFIG_HID_INTERRUPT_IN_EP_ADDR=0x81
#CONFIG_HID_INTERRUPT_OUT_EP_ADDR=0x01
#CONFIG_HID_REPORT_DESC_SIZE=317
#CONFIG_SUPPORT_USB_AUDIO_SOURCE=y
#CONFIG_USB_AUDIO_SOURCESINK=y
#CONFIG_USB_AUDIO_CONTROL_UNIT=y
#CONFIG_USB_AUDIO_DOWNLOAD_CHANNEL_NUM=2
#CONFIG_USB_AUDIO_UPLOAD_CHANNEL_NUM=1
#CONFIG_USB_AUDIO_DEVICE_SOURCE_IN_EP_ADDR=0x86
#CONFIG_USB_AUDIO_DEVICE_SINK_OUT_EP_ADDR=0x06
#CONFIG_USB_AUDIO_DEVICE_SINK_MAINCH_CONFIG=0x01
#CONFIG_USB_AUDIO_DEVICE_SINK_LOGICALCH01_CONFIG=0x03
#CONFIG_USB_AUDIO_DEVICE_SINK_LOGICALCH01_CONFIG=0x03

#usb hid
CONFIG_USB_DEVICE_HID=y
CONFIG_HID_INTERRUPT_OUT=y
CONFIG_USB_SELF_DEFINED_REPORT=y
CONFIG_SYS_LOG_USB_HID_LEVEL=2
CONFIG_USB_HID_DEVICE_IF_NUM=0
CONFIG_USB_HID_DEVICE_VID=0x10d6
CONFIG_USB_HID_DEVICE_PID=0xb012
CONFIG_HID_INTERRUPT_IN_EP_ADDR=0x81
CONFIG_HID_INTERRUPT_OUT_EP_ADDR=0x02

#usb cdc acm device
# CONFIG_USB_CDC_ACM=y
# CONFIG_UART_LINE_CTRL=y
# CONFIG_SYS_LOG_USB_CDC_ACM_LEVEL=2
# CONFIG_CDC_ACM_INTERRUPT_EP_ADDR=0x81
# CONFIG_CDC_ACM_BULK_IN_EP_ADDR=0x84
# CONFIG_CDC_ACM_BULK_OUT_EP_ADDR=0x03
# CONFIG_USB_CDC_ACM_MANUFACTURER="Actions"
# CONFIG_USB_CDC_ACM_PRODUCT="CDC-ACM-DEV"
# CONFIG_USB_CDC_ACM_SN="0123456789A"

#usb stub device config
#CONFIG_USB_DEVICE_STUB=y
#CONFIG_STUB_IN_EP_ADDR=0x86
#CONFIG_STUB_OUT_EP_ADDR=0x06
#CONFIG_SYS_LOG_USB_STUB_LEVEL=2
#CONFIG_STUB_EP_MPS=64
#CONFIG_USB_STUB_DEVICE_MANUFACTURER="Actions"
#CONFIG_USB_STUB_DEVICE_PRODUCT="USB-STUB-DEV"
#CONFIG_USB_STUB_DEVICE_SN="0123456789AB"

#usb mass storage config
#CONFIG_USB_AOTG_DC_MULTI_FIFO=n
#CONFIG_USB_MASS_STORAGE=y
#CONFIG_MASS_STORAGE_DISK_PDRV=4
#CONFIG_MASS_STORAGE_DISK_NAME="SD"
#CONFIG_SYS_LOG_USB_MASS_STORAGE_LEVEL=2
#CONFIG_MASS_STORAGE_MANUFACTURER="Actions"
#CONFIG_MASS_STORAGE_PRODUCT="MSC-Sample"
#CONFIG_MASS_STORAGE_SN="0123456798AB"
#CONFIG_MASS_STORAGE_STACK_SIZE=2048
#CONFIG_MASS_STORAGE_BUF_SIZE=8192
#CONFIG_USB_MASS_STORAGE_SHARE_THREAD=n
#CONFIG_MASS_STORAGE_IN_EP_ADDR=0x81
#CONFIG_MASS_STORAGE_OUT_EP_ADDR=0x02

#DISK
#CONFIG_DISK_ACCESS=y
#CONFIG_DISK_ACCESS_SD=y
#CONFIG_DISKIO_CACHE=n
CONFIG_MAIN_STACK_SIZE=3072

#usb dfu device config
#CONFIG_USB_DEVICE_DFU=y

#USB HOST
#CONFIG_USB_HOST=y
#CONFIG_USB_HOST_STACK=y
#CONFIG_USB_HOST_STORAGE=y
#Disk
#CONFIG_DISK_ACCESS_USB=y

#USB hotplug
#CONFIG_HOTPLUG=y
#CONFIG_HOTPLUG_MANAGER=y
#CONFIG_USB_HOTPLUG=y

#debug
CONFIG_NVRAM_CONFIG=y
```

## src/system_app_main.c
```c
/*
 * Copyright (c) 2012-2014 Wind River Systems, Inc.
 *
 * SPDX-License-Identifier: Apache-2.0
 */

#include <zephyr.h>
#include <sys/printk.h>
#include <drivers/usb/usb_phy.h>
#include <usb/usb_device.h>
// #include "usb_cdc_acm/usb_cdc_acm.h"
#include "usb_hid/usb_hid_handler.h"

#define LOG_LEVEL LOG_LEVEL_WRN
#include <logging/log.h>
LOG_MODULE_REGISTER(main);

int main(void)
{
	// if you would like to test cdc_acm: cancel comments of usb_phy_enter_b_idle, usb_phy_init, usb_cdc_acm_start
	// usb_phy_enter_b_idle();
	// usb_phy_init();
	// usb_cdc_acm_start();

	usb_hid_pre_init(NULL);

	while (1) {
		k_sleep(K_MSEC(1000));
	}
	return 0;
}
```
