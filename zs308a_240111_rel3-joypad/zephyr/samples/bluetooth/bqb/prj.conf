## CMakeLists.txt
```
# SPDX-License-Identifier: Apache-2.0

cmake_minimum_required(VERSION 3.20.0)

find_package(Zephyr REQUIRED HINTS $ENV{ZEPHYR_BASE})
project(bqb_test)

FILE(GLOB app_sources src/*.c)
target_sources(app PRIVATE ${app_sources})
```

## sample.yaml
```
sample:
  description: BQB Test sample, the simplest Zephyr
    application
  name: bt bqb test
common:
    tags: introduction
    harness: console
    harness_config:
      type: one_line
      regex:
        - "BQB Test! (.*)"
tests:
  sample.basic.helloworld:
    tags: introduction
```

## prj.conf
```kconfig
CONFIG_INPUT_DEV_ACTS_TP_KEY=n
CONFIG_PRINTK_TIME_FREFIX=n
CONFIG_SD_FS=y

CONFIG_BT_DRV=y
CONFIG_BT_ECC_ACTS=y
CONFIG_BT_HCI_ACTS=n
CONFIG_BT_CTRL_DEBUG=n
CONFIG_BT_CTRL_LOG=y
CONFIG_BT_CTRL_BQB=y
CONFIG_BT_CTRL_RF_DEBUG=n
CONFIG_BT_HCI_TX_PRINT=n
CONFIG_BT_HCI_RX_PRINT=n
CONFIG_BT_QC_TEST=n
```

## src/main.c
```c
#include <zephyr.h>
#include <stdlib.h>
#include <stdio.h>
#include <string.h>
#include <drivers/bluetooth/bt_drv.h>

static void bt_manager_set_bt_drv_param(void)
{
	btdrv_init_param_t param;

	memset(&param, 0, sizeof(param));
	param.set_hosc_cap = 1;
	param.hosc_capacity = 0x64;			/* Wait todo: get for config or nvram */
	param.set_max_rf_power = 1;
	param.bt_max_rf_tx_power = 38;		/* 8db */
	//param.set_ble_rf_power = 1;
	//param.ble_rf_tx_power = 34;

	btdrv_set_init_param(&param);
}

int main(void)
{
    int ret;

	/* init bt param */
	bt_manager_set_bt_drv_param();

	/* BQB mode [0:BR BQB Test, 1:BLE BQB Test, 2:BR/BLE dual BQB Test] */
	extern int bqb_init(int bqb_mode);
	ret = bqb_init(2);
	if (ret) {
		printk("[BQB] enter bqb mode failed (err %d)\n", ret);
	} else {
		printk("[BQB] enter bqb mode!\n");
	}

	while (1) {
		k_sleep(K_SECONDS(1));
	}
}
```
