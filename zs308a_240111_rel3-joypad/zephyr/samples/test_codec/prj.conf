## CMakeLists.txt
```
# SPDX-License-Identifier: Apache-2.0

#list(APPEND ZEPHYR_EXTRA_MODULES ${CMAKE_CURRENT_SOURCE_DIR}/../../modules/framework)


cmake_minimum_required(VERSION 3.13.1)

find_package(Zephyr REQUIRED HINTS $ENV{ZEPHYR_BASE})
project(test_codec)

target_sources(app PRIVATE src/system_app_main.c src/test_codec.c src/system_audio_policy.c src/card_reader.c)
```

## prj.conf
```kconfig
# nothing here
CONFIG_ACTIONS_FRAMEWORK=y
CONFIG_CORE=y
CONFIG_SYSTEM=y
CONFIG_SYS_WAKELOCK=n
CONFIG_MEDIA=y
CONFIG_MEDIA_PLAYER=y
CONFIG_MEDIA_EFFECT=n
CONFIG_VOICE_EFFECT=n
CONFIG_AUDIO=y
CONFIG_VOLUME_MANAGER=n
CONFIG_INPUT=y
CONFIG_INPUT_KEYPAD=y
CONFIG_POWER=n
CONFIG_MEMORY=y
CONFIG_APP_USED_MEM_POOL=y
CONFIG_PLAYTTS=y
CONFIG_PROPERTY=y
CONFIG_PROPERTY_CACHE=y
CONFIG_SECTION_OVERLAY=y
CONFIG_FS_MANAGER=y
CONFIG_SDFS_MANAGER=y
CONFIG_SYS_STANDBY=y
CONFIG_INPUT_MANAGER=y
CONFIG_I2CMT_LARK=n


CONFIG_ACTIONS_UTILS=y
CONFIG_ACTS_RING_BUFFER=y
CONFIG_ACTS_TRANSCODE=y
CONFIG_ACTS_EBERGY_STATISTICS=y
CONFIG_STREAM=y
CONFIG_ITERATOR=y

#CONFIG_BT_MAIN_APP=y
#CONFIG_BT_MUSIC_APP=y
#CONFIG_BT_CALL_APP=y
#CONFIG_TWS_APP=y
#CONFIG_AUDIO_INPUT_APP=y
#CONFIG_THREAD_TIMER=y
#CONFIG_LCMUSIC_APP=y

CONFIG_PRINTK_TIME_FREFIX=n

CONFIG_SD_FS=y

CONFIG_BLUETOOTH=n
CONFIG_ACTS_BT=n
CONFIG_BT_DRV=n
CONFIG_BT_HCI_ACTS=n
CONFIG_BT_ECC_ACTS=n
CONFIG_BT_CTRL_DEBUG=n
CONFIG_BT_CTRL_BQB=n
CONFIG_BT_CTRL_RF_DEBUG=n
CONFIG_BT_HCI_TX_PRINT=n
CONFIG_BT_HCI_RX_PRINT=n

CONFIG_BT_BREDR=n
CONFIG_BT_CONN_TX_MAX=12

CONFIG_BT_HCI_ACL_FLOW_CONTROL=n
CONFIG_BT_ATT_ENFORCE_FLOW=n
CONFIG_BT_GATT_DYNAMIC_DB=n

CONFIG_BT_MAX_CONN=3
CONFIG_BT_MAX_BR_CONN=2

CONFIG_BT_MAX_PAIRED=3
CONFIG_BT_MAX_BR_PAIRED=2

CONFIG_BT_HFP_HF=n
CONFIG_BT_HFP_AG=n
CONFIG_BT_HFP_MSBC=n
CONFIG_BT_A2DP=n
CONFIG_BT_AVRCP=n
CONFIG_BT_SPP=n
CONFIG_BT_PBAP_CLIENT=n
CONFIG_BT_MAP_CLIENT=n
CONFIG_BT_HID=n
CONFIG_BT_SDP_CLIENT=n

CONFIG_BT_PERIPHERAL=n
CONFIG_BT_BAS=n
CONFIG_BT_SMP=n
CONFIG_BT_SIGNING=n
# CONFIG_BT_PRIVACY=n
CONFIG_BT_TINYCRYPT_ECC=n

CONFIG_ACTS_BT_SHELL=n
CONFIG_BT_DEVICE_NAME="lark_bt"
CONFIG_BT_RX_BUF_LEN=680
CONFIG_BT_RX_BUF_COUNT=25
CONFIG_BT_HCI_CMD_COUNT=4
CONFIG_BT_L2CAP_TX_MTU=672

CONFIG_TWS=n
CONFIG_THREAD_TIMER=n
CONFIG_ACTS_RING_BUFFER=y
CONFIG_STREAM=y
CONFIG_RINGBUFF_STREAM=y
CONFIG_FILE_STREAM=y
CONFIG_MUTIPLE_VOLUME_MANAGER=y

CONFIG_CORE=y
CONFIG_SYSTEM=y
CONFIG_SYSTEM_SHELL=y
CONFIG_NUM_MBOX_ASYNC_MSGS=50
CONFIG_MESSAGE_DEBUG=n
CONFIG_DEVICE_SHELL=n
CONFIG_DATE_SHELL=n

CONFIG_ACTIONS_LIBRARY=y
CONFIG_ACTIONS_ALGORITHMS_LIBRARY=y
CONFIG_DSP=y
CONFIG_DSP_HAL=y
CONFIG_DSP_DEBUG_PRINT=y
CONFIG_LOAD_IMAGE_FROM_FS=y

CONFIG_AL_FORMAT_CHECK=y
CONFIG_ACTIONS_ENCODER=y
CONFIG_ENCODER_CVSD=n
CONFIG_ENCODER_CVSD_HW_ACCELERATION=n
CONFIG_ENCODER_SBC=n
CONFIG_ENCODER_SBC_HW_ACCELERATION=n
CONFIG_ENCODER_MSBC=n
CONFIG_ENCODER_MSBC_HW_ACCELERATION=n
CONFIG_ENCODER_MP3=n
CONFIG_ENCODER_MP3_HW_ACCELERATION=n
CONFIG_ENCODER_OPUS=n
CONFIG_ENCODER_OPUS_HW_ACCELERATION=n
CONFIG_ENCODER_PCM=y
CONFIG_ENCODER_WAV=n
CONFIG_ENCODER_WAV_HW_ACCELERATION=n

CONFIG_ACTIONS_DECODER=n
CONFIG_DECODER_AAC=n
CONFIG_DECODER_AAC_HW_ACCELERATION=n
CONFIG_DECODER_M4A=n
CONFIG_DECODER_M4A_HW_ACCELERATION=n
CONFIG_DECODER_ACT=n
CONFIG_DECODER_ACT_HW_ACCELERATION=n
CONFIG_DECODER_APE=n
CONFIG_DECODER_APE_HW_ACCELERATION=n
CONFIG_DECODER_CVSD=n
CONFIG_DECODER_CVSD_HW_ACCELERATION=n
CONFIG_DECODER_MSBC=n
CONFIG_DECODER_MSBC_HW_ACCELERATION=n
CONFIG_DECODER_SBC=n
CONFIG_DECODER_SBC_HW_ACCELERATION=n
CONFIG_DECODER_PCM=y
CONFIG_DECODER_MP3=n
CONFIG_DECODER_MP3_HW_ACCELERATION=n
CONFIG_DECODER_NAV=n
CONFIG_DECODER_NAV_HW_ACCELERATION=n
CONFIG_DECODER_FLAC=n
CONFIG_DECODER_FLAC_HW_ACCELERATION=n
CONFIG_DECODER_WAV=n
CONFIG_DECODER_WAV_HW_ACCELERATION=n
CONFIG_DECODER_WMA=n
CONFIG_DECODER_WMA_HW_ACCELERATION=n
CONFIG_SYS_CLOCK_TICKS_PER_SEC=1000

CONFIG_ACTIONS_PARSER=n
CONFIG_PARSER_MP3=n
CONFIG_PARSER_M4A=n
CONFIG_PARSER_WAV=n
CONFIG_PARSER_APE=n
CONFIG_PARSER_WMA=n
CONFIG_PARSER_FLAC=n

CONFIG_HOTPLUG=y
CONFIG_CARD_HOTPLUG=n
CONFIG_USB_HOTPLUG=y
CONFIG_MAIN_STACK_SIZE=2048
CONFIG_SYSTEM_WORKQUEUE_STACK_SIZE=2048

#USB device general config
CONFIG_USB_DEVICE=y
CONFIG_USB_AOTG_OTG=y
CONFIG_USB_AOTG_DC_ENABLED=y
CONFIG_USB_DEVICE_DRIVER=y
CONFIG_USB_DEVICE_STACK=y
CONFIG_SYS_LOG_USB_OTG_DRIVER_LEVEL=2
CONFIG_SYS_LOG_USB_DEVICE_LEVEL=2
CONFIG_USB_DEVICE_STRING_DESC_MAX_LEN=40
CONFIG_USB_AOTG_UDC_DMA=n
CONFIG_MASS_STORAGE_SWITCH_TO_ADFU=n

#usb mass storage config
CONFIG_USB_MASS_STORAGE=y
CONFIG_SYS_LOG_USB_MASS_STORAGE_LEVEL=2
CONFIG_MASS_STORAGE_MANUFACTURER="Actions"
CONFIG_MASS_STORAGE_PRODUCT="MSC-Sample"
CONFIG_MASS_STORAGE_SN="0123456798AB"
CONFIG_MASS_STORAGE_STACK_SIZE=2048
CONFIG_MASS_STORAGE_BUF_SIZE=8192
CONFIG_USB_MASS_STORAGE_SHARE_THREAD=n
CONFIG_USB_AOTG_DC_MULTI_FIFO=n

#thread stats config
CONFIG_THREAD_RUNTIME_STATS=y

CONFIG_DVFS=y
CONFIG_ACTS_DVFS_DYNAMIC_LEVEL=y
```

## boards/ats3085_dvb_watch.conf
```kconfig
CONFIG_DSP_IMAGE_PATH="/NAND:K/"

CONFIG_MMC=n
CONFIG_MMC_ACTS=n
CONFIG_SPINAND_ACTS=y
CONFIG_SPINAND_LIB=y
CONFIG_DMA_SPINAND_RESEVER_CHAN=9
CONFIG_DISK_ACCESS_SPINAND=y

#usb mass storage config
CONFIG_MASS_STORAGE_DISK_PDRV=1
CONFIG_MASS_STORAGE_DISK_NAME="NAND"
```

## boards/ats3085_dvb_watch_sdnand.conf
```kconfig
CONFIG_DSP_IMAGE_PATH="/SD:K/"

CONFIG_MMC=y
CONFIG_MMC_ACTS=y
CONFIG_MMC_SDCARD=y
CONFIG_DISK_ACCESS_SD=y
CONFIG_DISK_ACCESS_SPINAND=y
CONFIG_CARD_HOTPLUG=y

#usb mass storage config
CONFIG_MASS_STORAGE_DISK_PDRV=4
CONFIG_MASS_STORAGE_DISK_NAME="SD"
```

## boards/ats3085c_dvb_watch_ext_nor_max.conf
```kconfig
CONFIG_DSP_IMAGE_PATH="/NOR:K/"

CONFIG_SPINAND_ACTS=n
CONFIG_SPINAND_LIB=n
CONFIG_DISK_ACCESS_NOR=y

#usb mass storage config
CONFIG_MASS_STORAGE_DISK_PDRV=0
CONFIG_MASS_STORAGE_DISK_NAME="NOR"
```

## src/card_reader.c
```c
/*
 * Copyright (c) 2019 Actions Semiconductor Co., Ltd
 *
 * SPDX-License-Identifier: Apache-2.0
 */

/**
 * @file system app main
 */
#include <mem_manager.h>
#include <msg_manager.h>
#include <fw_version.h>
#include <sys_event.h>
#include <hotplug_manager.h>
#include <input_manager.h>
#include <thread_timer.h>
#include <stream.h>
#include <property_manager.h>
#include <fs_manager.h>
#include <usb/usb_device.h>
#include <usb/class/usb_msc.h>
#include <soc.h>
#include <sys_wakelock.h>
#include <drivers/usb/usb_phy.h>

struct cardreader_app_t {
	struct thread_timer monitor_timer;
	u32_t card_plugin:1;
	u32_t card_write_flag:1;
	u32_t card_state_change_cnt:8;
};

static void card_reader_moditor_handle(struct thread_timer *ttimer, void *expiry_fn_arg)
{
	struct cardreader_app_t *card_reader = (struct cardreader_app_t *)expiry_fn_arg;
	/**stub mode */
	if (usb_mass_storage_stub_mode()) {
		struct app_msg  msg = {0};
		msg.type = MSG_HOTPLUG_EVENT;
		msg.cmd = HOTPLUG_USB_STUB;
		msg.value = HOTPLUG_IN;
		send_async_msg("main", &msg);
	}

	if (!usb_hotplug_device_mode() || usb_mass_storage_ejected()) {
		struct app_msg  msg = {0};
		msg.type = MSG_HOTPLUG_EVENT;
		msg.cmd = HOTPLUG_USB_DEVICE;
		msg.value = HOTPLUG_OUT;
		send_async_msg("main", &msg);
	}

	if (usb_mass_storage_working()) {
		card_reader->card_write_flag = 1;
		card_reader->card_state_change_cnt = 0;
	} else {
		card_reader->card_state_change_cnt ++;
		if(card_reader->card_state_change_cnt >= 5) {
			card_reader->card_state_change_cnt = 0;
			card_reader->card_write_flag = 0;
			if(card_reader->card_plugin) {

			}
		}
	}
}

#ifdef CONFIG_USB_MASS_STORAGE
#define PAGE_SIZE	CONFIG_MASS_STORAGE_BUF_SIZE
static u8_t data_buf[PAGE_SIZE*2] __aligned(4) ;
#endif

int card_reader_init(void)
{
#ifdef CONFIG_HOTPLUG
#ifdef CONFIG_USB_MASS_STORAGE
	usb_disable();
	usb_phy_init();
	usb_phy_enter_b_idle();
	printk("%s -%d \n",__FUNCTION__,__LINE__);
	usb_mass_storage_init(NULL, data_buf, PAGE_SIZE*2);
#endif

#ifdef CONFIG_FS_MANAGER
	fs_manager_sdcard_enter_high_speed();
#endif
#endif

	return 0;
}

int card_reader_deinit(void)
{
#ifdef CONFIG_USB_MASS_STORAGE
	usb_mass_storage_exit();
#endif
#ifdef CONFIG_FS_MANAGER
	//fs_manager_disk_init("/SD:");
#endif

#ifdef CONFIG_FS_MANAGER
	fs_manager_sdcard_exit_high_speed();
#endif
	return 0;
}

int card_reader_mode_check(void)
{
	struct app_msg msg = {0};
	int result = 0;
	int res = 0;
	bool card_read_init_ok = false;
	bool terminaltion = false;
	bool exit_by_stub = false;
	struct cardreader_app_t *card_reader = NULL;

	if (!usb_hotplug_device_mode()) {
		return 0;
	}

	card_reader = app_mem_malloc(sizeof(struct cardreader_app_t));
	if (!card_reader) {
		return -ENOMEM;
	}

#ifdef CONFIG_THREAD_TIMER
	thread_timer_init(&card_reader->monitor_timer, card_reader_moditor_handle, card_reader);
	thread_timer_start(&card_reader->monitor_timer, 400, 400);
#endif

#ifdef CONFIG_SYS_WAKELOCK
	sys_wake_lock(FULL_WAKE_LOCK);
#endif

	if (!card_reader_init()) {
		card_read_init_ok = true;
	}
#ifdef CONFIG_HOTPLUG
	if (hotplug_manager_get_state(HOTPLUG_SDCARD) == HOTPLUG_IN) {
		card_reader->card_plugin = 1;
	}
#endif

	while (!terminaltion) {
		if (receive_msg(&msg, thread_timer_next_timeout())) {
			switch (msg.type) {
            case MSG_KEY_INPUT:
				if (msg.value == (KEY_POWER | KEY_TYPE_SHORT_UP)
					|| msg.value == (KEY_MENU | KEY_TYPE_SHORT_UP)) {
					if (!card_reader->card_write_flag) {
						terminaltion = true;
					}
				}
				break;
			case MSG_HOTPLUG_EVENT:
				if (msg.value == HOTPLUG_OUT) {
					switch (msg.cmd) {
						case HOTPLUG_USB_DEVICE:
							terminaltion = true;
							break;
						case HOTPLUG_SDCARD:
						#ifdef CONFIG_USB_MASS_STORAGE
                           usb_mass_storage_remove_lun();
                  		#endif
						#ifdef CONFIG_SEG_LED_MANAGER
							if (card_read_init_ok) {
								seg_led_display_icon(SLED_SD, false);
							}
						#endif
							card_reader->card_plugin = 0;
							break;
					}
				} else if (msg.value == HOTPLUG_IN) {
					if (msg.cmd == HOTPLUG_SDCARD) {
					#ifdef CONFIG_SEG_LED_MANAGER
						if (card_read_init_ok) {
							seg_led_display_icon(SLED_SD, true);
						}
					#endif
					#ifdef CONFIG_USB_MASS_STORAGE
						usb_mass_storage_add_lun(MSC_DISK_SD);
					#endif
						card_reader->card_plugin = 1;
					} else if (msg.cmd == HOTPLUG_USB_STUB) {
						terminaltion = true;
						exit_by_stub = true;
					}
				}
				break;
			default:
				SYS_LOG_ERR("error type: 0x%x! \n", msg.type);
				continue;
			}
			if (msg.callback != NULL)
				msg.callback(&msg, result, NULL);
		}
		thread_timer_handle_expired();
	}

	if (card_read_init_ok) {
		card_reader_deinit();
	}

	thread_timer_stop(&card_reader->monitor_timer);


	app_mem_free(card_reader);

#ifdef CONFIG_SYS_WAKELOCK
	sys_wake_unlock(FULL_WAKE_LOCK);
#endif
	return res;

}
```

## src/system_app_main.c
```c
/*
 * Copyright (c) 2019 Actions Semiconductor Co., Ltd
 *
 * SPDX-License-Identifier: Apache-2.0
 */

#include <fs_manager.h>
#include <file_stream.h>
#include <os_common_api.h>
#include <thread_timer.h>
#include <soc.h>
#include <media_player.h>
#include <srv_manager.h>
#include <app_manager.h>
#include <sys_manager.h>
#include <input_manager.h>

#define STORAGE_NAME "/"CONFIG_MASS_STORAGE_DISK_NAME":/"

extern int system_audio_init(void);
extern void system_audio_policy_init(void);
extern void system_init(void);
extern void *voice_player_start(const char *mic_in_url, const char *sco_in_url, const char *speaker_out_url, const char *sco_out_url); 
extern int voice_player_stop(media_player_t *player, bool force);


void sys_set_bt_host_wake_up_pending(uint8_t pending) {}
void sys_set_bt_ctrl_sleep_pending(uint8_t pending, u32_t sleep_time) {}

extern int card_reader_mode_check(void);
extern bool usb_hotplug_device_mode(void);
int main(void)
{
#ifdef CONFIG_SOC_DVFS_DYNAMIC_LEVEL
	soc_dvfs_set_level(SOC_DVFS_LEVEL_FULL_PERFORMANCE, "main");
#endif

	system_init();

	fs_manager_init();

	system_audio_policy_init();

#ifdef CONFIG_INPUT_MANAGER
	input_manager_init(NULL);
	/** input init is locked ,so we must unlock*/
	input_manager_unlock();
#endif

	if (usb_hotplug_device_mode()) {
		os_sleep(5000);
		card_reader_mode_check();
	}
	fs_unlink(STORAGE_NAME"spk_out.pcm");
	fs_unlink(STORAGE_NAME"sco_out.pcm");

	void *player = NULL;

	player = voice_player_start(STORAGE_NAME"mic_in.pcm", 
								STORAGE_NAME"sco_in.pcm",
								STORAGE_NAME"spk_out.pcm",
								STORAGE_NAME"sco_out.pcm");

	if (player)
		voice_player_stop(player, false);
	else
		return 0;

	return 0;
}

extern char z_main_stack[CONFIG_MAIN_STACK_SIZE];

APP_DEFINE(main, z_main_stack, CONFIG_MAIN_STACK_SIZE,\
			APP_PRIORITY, RESIDENT_APP,\
			NULL, NULL, NULL,\
			NULL, NULL);
```

## src/system_audio_policy.c
```c
/*
 * Copyright (c) 2019 Actions Semiconductor Co., Ltd
 *
 * SPDX-License-Identifier: Apache-2.0
 */

/**
 * @file system audio policy
 */

#include <os_common_api.h>
#include <mem_manager.h>
#include <msg_manager.h>
#include <string.h>
#include <audio_system.h>
#include <audio_policy.h>

#ifdef CONFIG_BT_TWS_US281B
#define MAX_AUDIO_VOL_LEVEL 32
#else
#define MAX_AUDIO_VOL_LEVEL 32
#endif

#ifdef CONFIG_DVFS
#include <dvfs.h>
#endif

#ifdef CONFIG_MEDIA
#if (MAX_AUDIO_VOL_LEVEL == 32)

/* unit: 0.1 dB */
const short voice_da_table[MAX_AUDIO_VOL_LEVEL] = {
	-1000, -440, -420, -400, -380, -360, -340, -320,
	 -300, -280, -260, -240, -225, -210, -195, -180,
	 -165, -150, -135, -120, -110, -100,  -90,  -80,
	  -70,  -60,  -50,  -40,  -30,  -20,  -10,    0,
};

/* unit: 0.001 dB */
const int voice_pa_table[MAX_AUDIO_VOL_LEVEL] = {
	-5000, -5000, -5000, -5000, -5000, -5000, -5000, -5000,
	-5000, -5000, -5000, -5000, -5000, -5000, -5000, -5000,
	-5000, -5000, -5000, -5000, -5000, -5000, -5000, -5000,
	-5000, -5000, -5000, -5000, -5000, -5000, -5000, -5000
};

/* unit: 0.1 dB */
const short music_da_table[MAX_AUDIO_VOL_LEVEL] = {
	-80, -80, -80, -80, -80, -80, -80, -80,
	-80, -80, -80, -80, -80, -80, -80, -80,
	-80, -80, -80, -72, -66, -60, -54, -48,
	-42, -36, -30, -24, -18, -12, -6, 0
};

/* unit: 0.001 dB */
const int music_pa_table[MAX_AUDIO_VOL_LEVEL] = {
	-60000, -52125, -46125, -40875, -36000, -31125, -28125, -25125,
	-22125, -19875, -18000, -16125, -14625, -13125, -11625, -10125,
	-8625, -7125, -5625, -4875, -4500, -4125, -3750, -3375,
	-2625, -2250, -1875, -1500, -1125, -750, -375, 0
};
#else

/* unit: 0.1 dB */
const short voice_da_table[MAX_AUDIO_VOL_LEVEL] = {
	-440, -400, -360, -320, -280, -240, -210, -180,
	-150, -120, -100,  -80,  -60,  -40,  -20,    0,
};

/* unit: 0.001 dB */
const int voice_pa_table[MAX_AUDIO_VOL_LEVEL] = {
	-5000, -5000, -5000, -5000,
	-5000, -5000, -5000, -5000,
	-5000, -5000, -5000, -5000,
	-5000, -5000, -5000, -5000,
};

/* unit: 0.1 dB */
const short music_da_table[MAX_AUDIO_VOL_LEVEL] = {
	-80, -80, -80, -72, -66, -60, -54, -48,
	-42, -36, -30, -24, -18, -12, -6, 0
};

/* unit: 0.001 dB */
const int music_pa_table[MAX_AUDIO_VOL_LEVEL] = {
	-100000, -49000, -39000, -33000, -28000, -24000, -21000, -18000,
	-15000, -12000, -10000, -8000,  -6000, -4000, -2000, 0,
};

#endif


const short usound_da_table[16] = {
	0, 0, 0, 0,
	0, 0, 0, 0,
	0, 0, 0, 0,
	0, 0, 0, 0,
};

const int usound_pa_table[16] = {
       -59000, -44000, -38000, -33900,
       -29000, -24000, -22000, -19400,
       -17000, -14700, -12300, -10000,
       -7400,  -5000,  -3000,  0,
};

#ifdef CONFIG_TOOL_ASET
static aset_volume_table_v2_t aset_volume_table;
#endif

static const struct audio_policy_t system_audio_policy = {
#ifdef CONFIG_AUDIO_OUTPUT_I2S
	.audio_out_channel = AUDIO_CHANNEL_I2STX,
#elif CONFIG_AUDIO_OUTPUT_SPDIF
	.audio_out_channel = AUDIO_CHANNEL_SPDIFTX,
#elif CONFIG_AUDIO_OUTPUT_DAC_AND_I2S
	.audio_out_channel = AUDIO_CHANNEL_DAC | AUDIO_CHANNEL_I2STX,
#else
	.audio_out_channel = AUDIO_CHANNEL_DAC,
#endif

	.audio_in_linein_gain = 0, // 0db
	.audio_in_fm_gain = 0, // 0db
	.audio_in_mic_gain = 365, // 36.5db

#ifdef CONFIG_AEC_TAIL_LENGTH
	.voice_aec_tail_length_16k = CONFIG_AEC_TAIL_LENGTH,
	.voice_aec_tail_length_8k = CONFIG_AEC_TAIL_LENGTH * 2,
#endif

	.tts_fixed_volume = 1,
	.volume_saveto_nvram = 1,

	.audio_out_volume_level = MAX_AUDIO_VOL_LEVEL - 1,
	.music_da_table = music_da_table,
	.music_pa_table = music_pa_table,
	.voice_da_table = voice_da_table,
	.voice_pa_table = voice_pa_table,
	.usound_da_table = usound_da_table,
	.usound_pa_table = usound_pa_table,

#ifdef CONFIG_TOOL_ASET
	.aset_volume_table = &aset_volume_table,
#endif
};

#endif /* CONFIG_MEDIA */

void system_audio_policy_init(void)
{
#ifdef CONFIG_MEDIA
	audio_policy_register(&system_audio_policy);

#ifdef CONFIG_OUTPUT_RESAMPLE
	if ((system_audio_policy.audio_out_channel & AUDIO_CHANNEL_I2STX) == AUDIO_CHANNEL_I2STX
	|| (system_audio_policy.audio_out_channel & AUDIO_CHANNEL_SPDIFTX) == AUDIO_CHANNEL_SPDIFTX) {
		audio_system_set_output_sample_rate(48);
#ifdef CONFIG_DVFS_DYNAMIC_LEVEL
		dvfs_set_level(DVFS_LEVEL_HIGH_PERFORMANCE, "media");
		SYS_LOG_INF("dvfs level %d\n", DVFS_LEVEL_HIGH_PERFORMANCE);
#endif
	}
#endif
#endif

}
```

## src/test_codec.c
```c
/*
 * Copyright (c) 2019 Actions Semiconductor Co., Ltd
 *
 * SPDX-License-Identifier: Apache-2.0
 */
#include <os_common_api.h>
#include <stdio.h>
#include <string.h>
#include <file_stream.h>
#include <stream.h>
#include <media_player.h>
#include <audio_system.h>

static io_stream_t open_file_stream(const char *url, int mode)
{
	io_stream_t stream = file_stream_create((void*)url);

	if (!stream)
		return NULL;

	if (stream_open(stream, mode)) {
		stream_destroy(stream);
		return NULL;
	}

	return stream;
}

static void close_stream(io_stream_t stream)
{
	if (stream) {
		stream_close(stream);
		stream_destroy(stream);
	}
}

static io_stream_t mic_in_stream;
static io_stream_t bt_in_stream;
static io_stream_t bt_out_stream;
static io_stream_t spk_out_stream;

void *voice_player_start(const char *mic_in_url, const char *bt_in_url, const char *speaker_out_url, const char *bt_out_url)
{
	media_init_param_t init_param;
	media_player_t *player = NULL;

	memset(&init_param, 0, sizeof(init_param));

	mic_in_stream = open_file_stream(mic_in_url, MODE_IN);
	if (!mic_in_stream) {
		SYS_LOG_ERR("stream open failed (%s)\n", mic_in_url);
		goto err_exit;
	}

	bt_in_stream = open_file_stream(bt_in_url, MODE_IN);
	if (!bt_in_stream) {
		SYS_LOG_ERR("stream open failed (%s)\n", bt_in_url);
		goto err_exit;
	}

	bt_out_stream = open_file_stream(bt_out_url, MODE_OUT);
	if (!bt_out_stream) {
		SYS_LOG_ERR("stream open failed (%s)\n", bt_out_url);
		goto err_exit;
	}

	spk_out_stream = open_file_stream(speaker_out_url, MODE_OUT);
	if (!spk_out_stream) {
		SYS_LOG_ERR("stream open failed (%s)\n", speaker_out_url);
		goto err_exit;
	}

	init_param.type = MEDIA_SRV_TYPE_PLAYBACK_AND_CAPTURE;
	init_param.stream_type = AUDIO_STREAM_VOICE;
	init_param.efx_stream_type = AUDIO_STREAM_VOICE;
	init_param.format = PCM_TYPE;
	init_param.sample_rate = 48;
	init_param.channels = 2;
	init_param.input_stream = bt_in_stream;
	init_param.output_stream = spk_out_stream;
	init_param.capture_format = PCM_TYPE;
	init_param.capture_sample_rate_input = 16;
	init_param.capture_sample_rate_output = 16;
	init_param.capture_channels_input = 1;
	init_param.capture_channels_output = 1;
	init_param.capture_bit_rate = 16;
	init_param.capture_input_stream = mic_in_stream;
	init_param.capture_output_stream = bt_out_stream;
	init_param.dumpable = true;
	init_param.event_notify_handle = NULL;

	SYS_LOG_INF("bt_in_stream %p, spk_out_stream %p, mic_in_stream %p, bt_out_stream %p \n", bt_in_stream, spk_out_stream, mic_in_stream, bt_out_stream);
	player = media_player_open(&init_param);
	if (!player) {
		SYS_LOG_ERR("media_player_open failed\n");
		goto err_exit;
	}

	media_player_play(player);
	return player;
err_exit:
	if (mic_in_stream)
		close_stream(mic_in_stream);
	if (bt_in_stream)
		close_stream(bt_in_stream);
	if (bt_out_stream)
		close_stream(bt_out_stream);
	if (spk_out_stream)
		close_stream(spk_out_stream);
	return NULL;
}

int voice_player_stop(media_player_t *player, bool force)
{
	if (!player || force)
		goto out_exit;

	if (mic_in_stream) {
		int inlen = stream_get_length(bt_in_stream);
		int miclen = stream_get_length(mic_in_stream);
		do {
			os_sleep(1000);
			int outlen = stream_get_length(spk_out_stream);
			int sco_outlen = stream_get_length(bt_out_stream);

			//int newlen = stream_get_length(mic_in_stream);
			SYS_LOG_INF("dec in stream len %d, out stream len %d\n", inlen, outlen);
			SYS_LOG_INF("enc in stream len %d, out stream len %d\n", miclen, sco_outlen);
			if (inlen == outlen && miclen == sco_outlen)
				break;
		} while (1);
	}

out_exit:
	if (player) {
		media_player_stop(player);
		media_player_close(player);
	}

	if (mic_in_stream) {
		close_stream(mic_in_stream);
		mic_in_stream = NULL;
	}
	if (bt_in_stream) {
		close_stream(bt_in_stream);
		bt_in_stream = NULL;
	}
	if (bt_out_stream) {
		close_stream(bt_out_stream);
		bt_out_stream = NULL;
	}
	if (spk_out_stream) {
		close_stream(spk_out_stream);
		spk_out_stream = NULL;
	}
	return 0;
}
```
