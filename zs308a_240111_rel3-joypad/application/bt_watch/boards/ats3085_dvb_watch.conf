## zs308a_240111_rel3-joypad/framework/display/memory/Kconfig
```kconfig
# Kconfig - Actions memory manager

#
# Copyright (c) 2016 Actions Corporation
#
# SPDX-License-Identifier: Apache-2.0
#

menuconfig UI_MEMORY_MANAGER
	bool "ui memory manager"
	help
	  This option enables ui memory manager

if UI_MEMORY_MANAGER

config UI_MEM_BLOCK_SIZE
	int "Block size (in bytes)"
	default 32
	help
	  This option specifies the size of block in bytes.

config UI_MEM_NUMBER_BLOCKS
	int "Number of Blocks"
	default 0
	help
	  This option specifies the block number. A value of zero
	  means that no framebuffer block is defined.

config UI_GUI_SRAM_POOL_SIZE
	int "GUI sram pool size (in bytes)"
	default 0
	help
	  This option specifies the size of the GUI sram pool. A size of zero
	  means that no GUI sram pool is defined.

config UI_RES_MEM_POOL_SIZE
	int "Resource memory pool size (in bytes)"
	default 0
	help
	  This option specifies the size of the resource memory pool. A size of
	  zero means that no resource memory pool is defined.

config UI_MEMORY_DEBUG
	bool "ui memory debug"
	depends on MEM_GUARD
	help
	  This option enables ui memory debug

endif # UI_MEMORY_MANAGER
```

## zs308a_240111_rel3-joypad/framework/sensor/Kconfig
```kconfig
# Kconfig - Actions Sensor manager

#
# Copyright (c) 2016 Actions Corporation
#
# SPDX-License-Identifier: Apache-2.0
#

if SENSOR

config SENSOR_MANAGER
	bool
	prompt "Sensor Manager Support"
	select SENSOR_SERVICE
	select SENSOR_HAL
	select SENSOR_ALGO
	default n
	help
	This option enables actions sensor manager.

config SENSOR_SERVICE
	bool
	prompt "Sensor Service Support"
	default n
	help
	This option enables actions sensor service.

endif # SENSOR
```

## zs308a_240111_rel3-joypad/zephyr/boards/arm/ats3085c_dvb_watch_bootnand/Kconfig.board
```kconfig
# STM32F469I-DISCO board configuration

# Copyright (c) 2016 Linaro Limited.
# SPDX-License-Identifier: Apache-2.0

config BOARD_ATS3085C_DVB_WATCH_BOOTNAND
	bool "ATS3085C dvb watch boot+nand Development Board"
	depends on SOC_LARK
```

## zs308a_240111_rel3-joypad/zephyr/boards/arm/ats3085c_dvb_watch_ext_nor_max/Kconfig.board
```kconfig
# STM32F469I-DISCO board configuration

# Copyright (c) 2016 Linaro Limited.
# SPDX-License-Identifier: Apache-2.0

config BOARD_ATS3085C_DVB_WATCH_EXT_NOR_MAX
	bool "ATS3085C dvb watch EXT NOR  MAX Development Board"
	depends on SOC_LARK
```

## zs308a_240111_rel3-joypad/zephyr/boards/arm/ats3085l_dvb_watch_ext_nor/Kconfig.board
```kconfig
# STM32F469I-DISCO board configuration

# Copyright (c) 2016 Linaro Limited.
# SPDX-License-Identifier: Apache-2.0

config BOARD_ATS3085L_DVB_WATCH_EXT_NOR
	bool "ATS3085L dvb watch ext nor Development Board"
	depends on SOC_LARK
```

## zs308a_240111_rel3-joypad/zephyr/boards/arm/lark_evb/Kconfig.defconfig
```kconfig
# Copyright (c) 2016 Linaro Limited.
# SPDX-License-Identifier: Apache-2.0

if BOARD_LARK_EVB

config BOARD
	default "lark_evb"


if DISPLAY

config PANEL_GC9C01
    default y

endif # DISPLAY

if LOG

config LOG_BUFFER_SIZE
	default 4096

config LOG_DETECT_MISSED_STRDUP
    default n

endif # LOG


if SHELL_DBG

config KERNEL_SHELL
	default y

config DEVICE_SHELL
	default y

config POSIX_CLOCK
	default y

config DATE_SHELL
	default y

config INIT_STACKS
	default y

config THREAD_STACK_INFO
	default y

config THREAD_MONITOR
	default y

config THREAD_NAME
	default y

if GPIO

config GPIO_SHELL
	default y

endif # GPIO

if FILE_SYSTEM

config FILE_SYSTEM_SHELL
	default y

endif # FILE_SYSTEM

if FLASH

config FLASH_SHELL
	default y

endif # FLASH

if FLASH_MAP

config FLASH_MAP_SHELL
	default y

endif # FLASH_MAP

endif # SHELL_DBG

if SPINAND_ACTS
config SPI_HOST
	default 3
endif # SPINAND_ACTS

endif # BOARD_LARK_DVB_WATCH
```

## zs308a_240111_rel3-joypad/zephyr/drivers/display/engine/Kconfig
```kconfig
# Configuration options for Actions Display Accelerator

# Copyright (c) 2020 Actions Technology Co., Ltd
# SPDX-License-Identifier: Apache-2.0

menuconfig DISPLAY_ENGINE
	bool "Display Engine"
	help
	  Enable display engine

if DISPLAY_ENGINE

module = DISPLAY_ENGINE
module-str = display_engine
source "subsys/logging/Kconfig.template.log_config"

config DISPLAY_ENGINE_INSTANCE_NUM
	int "Display Engine Instance Number"
	default 3
	help
	  Set display engine maximum instances to support

config DISPLAY_ENGINE_HIHG_PRIO_INSTANCE
	bool "Support Display Engine High Priority Instance"
	help
	  Support display engine high priority instance

config DISPLAY_ENGINE_DRAW_COMMAND_NUM
	int "Display Engine Command Number Per Instance"
	default 10
	help
	  Set display engine maximum instances commands to support

config DISPLAY_ENGINE_POST_COMMAND_NUM
	int "Display Engine Command Number Per Instance"
	default 3
	help
	  Set display engine maximum instances commands to support

config DISPLAY_ENGINE_COMMAND_TIMEOUT_MS
	int "Display Engine Command Timeout in Milliseconds"
	default 500
	help
	  Set display engine command timeout in milliseconds

endif # DISPLAY_ENGINE
```

## zs308a_240111_rel3-joypad/zephyr/drivers/display/panel/Kconfig.panel_sh8601z0
```kconfig
# SH8601Z0 display driver configuration options

# Copyright (c) 2019 Marc Reilly <marc@cpdesign.com.au>
# SPDX-License-Identifier: Apache-2.0

menuconfig PANEL_SH8601Z0
	bool "SH8601Z0 display driver"
	help
	  Enable driver for SH8601Z0 display driver.

if PANEL_SH8601Z0

endif # PANEL_SH8601Z0
```

## zs308a_240111_rel3-joypad/zephyr/drivers/display/panel/Kconfig.panel_st77903
```kconfig
# ST77903 display driver configuration options

# Copyright (c) 2019 Marc Reilly <marc@cpdesign.com.au>
# SPDX-License-Identifier: Apache-2.0

menuconfig PANEL_ST77903
	bool "ST77903 display driver"
	help
	  Enable driver for ST77903 display driver.

if PANEL_ST77903

endif # PANEL_ST77903
```
