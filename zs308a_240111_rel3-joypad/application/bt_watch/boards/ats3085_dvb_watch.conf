## zs308a_240111_rel3-joypad/application/bt_watch/boards/ats3085_dvb_watch.conf
```kconfig
CONFIG_DSP_IMAGE_PATH="/NAND:K/"

CONFIG_LV_MEM_SIZE_KILOBYTES=96
CONFIG_UI_MEM_BLOCK_SIZE=412232
CONFIG_LVGL_VDB_SIZE=34512
CONFIG_UI_GUI_SRAM_POOL_SIZE=10240
CONFIG_UI_RES_MEM_POOL_SIZE=2200000
CONFIG_BITMAP_PER_FONT_CACHE_SIZE=98304
CONFIG_BITMAP_FONT_CACHE_POOL_SIZE=300000

CONFIG_OTA_TEMP_PART_DEV_NAME="spinand"

#usb mass storage config
CONFIG_MASS_STORAGE_DISK_PDRV=1
CONFIG_MASS_STORAGE_DISK_NAME="NAND"

#psram config
CONFIG_PSRAM_SIZE=8192

CONFIG_SPINAND_ACTS=y
CONFIG_SPINAND_LIB=y

CONFIG_DISK_ACCESS_SPINAND=y
CONFIG_APP_UI_DISK="/NAND:A"
CONFIG_APP_FONT_DISK="/NAND:C"
CONFIG_APP_FAT_DISK="/NAND:"
CONFIG_APP_UI_DISK_B="/NAND:B"
CONFIG_WELCOME_UI_DISK="/NAND:K"

CONFIG_IPMSG_BTC_FCC_NAME="/NAND:K/fcc.bin"

CONFIG_USER_WORK_Q=y
CONFIG_USER_WORK_Q_PRIORITY=8

#enable auto search for res_b
CONFIG_RES_MANAGER_DISABLE_AUTO_SEARCH_FILES=n

#disable ram code for sensor
CONFIG_SENSOR_RAM_CODE_SIZE=0
```

## zs308a_240111_rel3-joypad/application/bt_watch/boards/ats3085_dvb_watch_sdnand.conf
```kconfig
CONFIG_DSP_IMAGE_PATH="/SD:K/"

CONFIG_LV_MEM_SIZE_KILOBYTES=96
CONFIG_UI_MEM_BLOCK_SIZE=412232
CONFIG_LVGL_VDB_SIZE=34512
CONFIG_UI_GUI_SRAM_POOL_SIZE=10240
CONFIG_UI_RES_MEM_POOL_SIZE=2200000
CONFIG_BITMAP_PER_FONT_CACHE_SIZE=98304
CONFIG_BITMAP_FONT_CACHE_POOL_SIZE=300000

CONFIG_OTA_TEMP_PART_DEV_NAME="sd"

#usb mass storage config
CONFIG_MASS_STORAGE_DISK_PDRV=4
CONFIG_MASS_STORAGE_DISK_NAME="SD"

#psram config
CONFIG_PSRAM_SIZE=8192

CONFIG_MMC=y
CONFIG_MMC_ACTS=y
CONFIG_MMC_SDCARD=y
CONFIG_DISK_ACCESS_SD=y


CONFIG_DISK_ACCESS_SPINAND=y
CONFIG_APP_UI_DISK="/SD:A"
CONFIG_APP_FONT_DISK="/SD:C"
CONFIG_APP_FAT_DISK="/SD:"
CONFIG_APP_UI_DISK_B="/SD:B"
CONFIG_WELCOME_UI_DISK="/SD:K"

CONFIG_IPMSG_BTC_FCC_NAME="/SD:K/fcc.bin"

CONFIG_USER_WORK_Q=y
CONFIG_USER_WORK_Q_PRIORITY=8

#disable ram code for sensor
CONFIG_SENSOR_RAM_CODE_SIZE=0
```

## zs308a_240111_rel3-joypad/application/bt_watch/boards/ats3085c_dvb_watch_bootnand.conf
```kconfig
CONFIG_DSP_IMAGE_PATH="/NAND:K/"

CONFIG_LV_MEM_SIZE_KILOBYTES=64
CONFIG_UI_MEM_BLOCK_SIZE=259200
CONFIG_LVGL_VDB_SIZE=21600
CONFIG_UI_GUI_SRAM_POOL_SIZE=10240
CONFIG_UI_RES_MEM_POOL_SIZE=1100000
CONFIG_BITMAP_PER_FONT_CACHE_SIZE=49152
CONFIG_BITMAP_FONT_CACHE_POOL_SIZE=230000

CONFIG_OTA_TEMP_PART_DEV_NAME="spinand"

#usb mass storage config
CONFIG_MASS_STORAGE_DISK_PDRV=1
CONFIG_MASS_STORAGE_DISK_NAME="NAND"

#psram config
#CONFIG_PSRAM_SIZE=6144

CONFIG_SLEEP_SENSOR_RUN_ON_NOR=n

CONFIG_SPINAND_ACTS=y
CONFIG_SPINAND_LIB=y

CONFIG_DISK_ACCESS_SPINAND=y
CONFIG_APP_UI_DISK="/NAND:A"
CONFIG_APP_FONT_DISK="/NAND:C"
CONFIG_APP_FAT_DISK="/NAND:"
CONFIG_APP_UI_DISK_B="/NAND:B"
CONFIG_WELCOME_UI_DISK="/NAND:K"


CONFIG_IPMSG_BTC_FCC_NAME="/NAND:K/fcc.bin"
CONFIG_USER_WORK_Q=y
CONFIG_USER_WORK_Q_PRIORITY=8
```

## zs308a_240111_rel3-joypad/application/bt_watch/boards/ats3085l_dvb_watch_bootnand.conf
```kconfig
CONFIG_DSP_IMAGE_PATH="/NAND:K/"

CONFIG_VIEW_SCROLL_MEM_LOWEST=y

CONFIG_LV_MEM_SIZE_KILOBYTES=38
CONFIG_VIEW_CACHE_LEVEL=1
CONFIG_UI_MEM_NUMBER_BLOCKS=5
CONFIG_UI_MEM_BLOCK_SIZE=259200
CONFIG_LVGL_VDB_SIZE=16560
CONFIG_UI_GUI_SRAM_POOL_SIZE=10240
CONFIG_UI_RES_MEM_POOL_SIZE=380000
CONFIG_BITMAP_PER_FONT_CACHE_SIZE=23552
CONFIG_BITMAP_FONT_CACHE_POOL_SIZE=60000
CONFIG_BITMAP_FONT_SUPPORT_EMOJI=n

CONFIG_OTA_TEMP_PART_DEV_NAME="spinand"

#usb mass storage config
CONFIG_MASS_STORAGE_DISK_PDRV=1
CONFIG_MASS_STORAGE_DISK_NAME="NAND"

#psram config
#CONFIG_PSRAM_SIZE=2048

CONFIG_SLEEP_SENSOR_RUN_ON_NOR=n

CONFIG_SPINAND_ACTS=y
CONFIG_SPINAND_LIB=y

CONFIG_DISK_ACCESS_SPINAND=y
CONFIG_APP_UI_DISK="/NAND:A"
CONFIG_APP_FONT_DISK="/NAND:C"
CONFIG_APP_FAT_DISK="/NAND:"
CONFIG_APP_UI_DISK_B="/NAND:B"
CONFIG_WELCOME_UI_DISK="/NAND:K"


CONFIG_IPMSG_BTC_FCC_NAME="/NAND:K/fcc.bin"
CONFIG_USER_WORK_Q=y
CONFIG_USER_WORK_Q_PRIORITY=8

#disable ram code for sensor
CONFIG_SENSOR_RAM_CODE_SIZE=0
```

## zs308a_240111_rel3-joypad/application/bt_watch_call/boards/ats3085l_dvb_watch_ext_nor_max.conf
```kconfig
CONFIG_DSP_IMAGE_PATH="/NOR:K/"

CONFIG_VIEW_SCROLL_MEM_LOWEST=y

CONFIG_LV_MEM_SIZE_KILOBYTES=48
CONFIG_VIEW_CACHE_LEVEL=1
CONFIG_UI_MEM_NUMBER_BLOCKS=5
CONFIG_UI_MEM_BLOCK_SIZE=259200
CONFIG_LVGL_VDB_SIZE=21600
CONFIG_UI_GUI_SRAM_POOL_SIZE=10240
CONFIG_UI_RES_MEM_POOL_SIZE=480000
CONFIG_BITMAP_PER_FONT_CACHE_SIZE=23552
CONFIG_BITMAP_FONT_CACHE_POOL_SIZE=95000

CONFIG_OTA_TEMP_PART_DEV_NAME="spi_flash"

#usb mass storage config
CONFIG_MASS_STORAGE_DISK_PDRV=0
CONFIG_MASS_STORAGE_DISK_NAME="NOR"

#psram config
#CONFIG_PSRAM_SIZE=4096

CONFIG_SPINAND_ACTS=n
CONFIG_SPINAND_LIB=n

CONFIG_DISK_ACCESS_NOR=y
CONFIG_APP_UI_DISK="/NOR:A"
CONFIG_APP_FONT_DISK="/NOR:C"
CONFIG_APP_FAT_DISK="/NOR:"
CONFIG_APP_UI_DISK_B="/NOR:B"
CONFIG_WELCOME_UI_DISK="/NOR:K"

CONFIG_MASS_STORAGE_BUF_SIZE=4096

CONFIG_IPMSG_BTC_FCC_NAME="/NOR:K/fcc.bin"

CONFIG_USER_WORK_Q=y
CONFIG_USER_WORK_Q_PRIORITY=8
```

## zs308a_240111_rel3-joypad/application/bt_watch_call/src/launcher/Kconfig
```kconfig
# Kconfig - ACTIONS primitive options for sdk version 2.0

#
# Copyright (c) 2015 Intel Corporation
#
# Licensed under the Apache License, Version 2.0 (the "License");
# you may not use this file except in compliance with the License.
# You may obtain a copy of the License at
#
#     http://www.apache.org/licenses/LICENSE-2.0
#
# Unless required by applicable law or agreed to in writing, software
# distributed under the License is distributed on an "AS IS" BASIS,
# WITHOUT WARRANTIES OR CONDITIONS OF ANY KIND, either express or implied.
# See the License for the specific language governing permissions and
# limitations under the License.
#

config LAUNCHER_APP
	bool "Launcher App"
	default n
	help
	  Enable launcher app

if LAUNCHER_APP

config CLOCK_DEF_REFR_PERIOD
	int "Clock Default Update Period in Milliseconds"
	default 1000
	help
	  Set clock default update period in milliseconds

config CLOCK_SELECTOR_USE_VIEW_SLIDING
	bool "Clock Selector Implemention Use View Sliding"
	default y
	help
	  Clock selector implemention use view sliding to accelerate performance

endif # LAUNCHER_APP
```

## zs308a_240111_rel3-joypad/application/bt_watch_no_psram/boards/ats3085p_dvb_watch_ext_nor.conf
```kconfig
CONFIG_DSP_IMAGE_PATH="/NOR:K/"

CONFIG_LVGL_VDB_SIZE=3960
CONFIG_LV_MEM_SIZE_KILOBYTES=10

CONFIG_UI_MEM_NUMBER_BLOCKS=0
CONFIG_UI_MEM_BLOCK_SIZE=259200
CONFIG_UI_RES_MEM_POOL_SIZE=100500

#usb mass storage config
CONFIG_MASS_STORAGE_DISK_PDRV=0
CONFIG_MASS_STORAGE_DISK_NAME="NOR"
CONFIG_OTA_TEMP_PART_DEV_NAME="spi_flash"

CONFIG_SPINAND_ACTS=n
CONFIG_SPINAND_LIB=n

CONFIG_DISK_ACCESS_NOR=y
CONFIG_BITMAP_FONT_CACHE_POOL_SIZE=64
CONFIG_APP_UI_DISK="/NOR:A"
CONFIG_APP_FONT_DISK="/NOR:C"
CONFIG_APP_FAT_DISK="/NOR:"
CONFIG_APP_UI_DISK_B="/NOR:B"
CONFIG_WELCOME_UI_DISK="/NOR:K"

CONFIG_MASS_STORAGE_BUF_SIZE=4096

CONFIG_IPMSG_BTC_FCC_NAME="/NOR:K/fcc.bin"

CONFIG_USER_WORK_Q=y
CONFIG_USER_WORK_Q_PRIORITY=8
```

## zs308a_240111_rel3-joypad/application/joypad/boards/ats3085_dvb_watch.conf
```kconfig
CONFIG_DSP_IMAGE_PATH="/NAND:K/"

CONFIG_UI_MEM_BLOCK_SIZE=412232
#CONFIG_GUI_TEXT_IMG_CACHE_SIZE=1200000

#usb mass storage config
CONFIG_MASS_STORAGE_DISK_PDRV=1
CONFIG_MASS_STORAGE_DISK_NAME="NAND"

#psram config
CONFIG_PSRAM_SIZE=8192

CONFIG_SPINAND_ACTS=y
CONFIG_SPINAND_LIB=y

CONFIG_DISK_ACCESS_SPINAND=y
CONFIG_APP_UI_DISK="/NAND:A"
CONFIG_APP_FONT_DISK="/NAND:C"
CONFIG_APP_FAT_DISK="/NAND:"
CONFIG_APP_UI_DISK_B="/NAND:B"
CONFIG_WELCOME_UI_DISK="/NAND:K"
```

## zs308a_240111_rel3-joypad/application/joypad/src/main/Kconfig
```kconfig
# Kconfig - ACTIONS primitive options for sdk version 2.0

#
# Copyright (c) 2015 Intel Corporation
#
# Licensed under the Apache License, Version 2.0 (the "License");
# you may not use this file except in compliance with the License.
# You may obtain a copy of the License at
#
#     http://www.apache.org/licenses/LICENSE-2.0
#
# Unless required by applicable law or agreed to in writing, software
# distributed under the License is distributed on an "AS IS" BASIS,
# WITHOUT WARRANTIES OR CONDITIONS OF ANY KIND, either express or implied.
# See the License for the specific language governing permissions and
# limitations under the License.
#

config BT_HID_APP
	bool
	prompt "Enable/Disable BT HID APP"
	default n
	help
	This option enable or disable bthid app

config BT_SPP_APP
	bool
	prompt "Enable/Disable BT SPP APP"
	default n
	help
	This option enable or disable btspp app

config USB_HID_APP
	bool
	prompt "Enable/Disable USB HID APP"
	default n
	help
	This option enable or disable usbhid app

config BT_BLE_VENDER_GATT_APP
	bool
	prompt "Enable/Disable BT BLE VENDER GATT APP"
	default n
	help
	This option enable or disable usbhid app
```

## zs308a_240111_rel3-joypad/application/view_demo/boards/ats3085c_dvb_watch_ext_nor.conf
```kconfig
CONFIG_DSP_IMAGE_PATH="/NOR:K/"

CONFIG_UI_MEM_BLOCK_SIZE=259200
#CONFIG_GUI_TEXT_IMG_CACHE_SIZE=300000

#usb mass storage config
CONFIG_MASS_STORAGE_DISK_PDRV=0
CONFIG_MASS_STORAGE_DISK_NAME="NOR"

#psram config
CONFIG_PSRAM_SIZE=4096

CONFIG_SPINAND_ACTS=n
CONFIG_SPINAND_LIB=n

CONFIG_DISK_ACCESS_NOR=y
CONFIG_APP_UI_DISK="/NOR:A"
CONFIG_APP_FONT_DISK="/NOR:C"
CONFIG_APP_FAT_DISK="/NOR:"
CONFIG_APP_UI_DISK_B="/NOR:B"
CONFIG_WELCOME_UI_DISK="/NOR:K"
```

## zs308a_240111_rel3-joypad/bootloader/boards/arm/ats3085_dvb_watch/Kconfig.board
```kconfig
# STM32F469I-DISCO board configuration

# Copyright (c) 2016 Linaro Limited.
# SPDX-License-Identifier: Apache-2.0

config BOARD_ATS3085_DVB_WATCH
	bool "ATS3085 dvb watch Development Board"
	depends on SOC_LARK
```

## zs308a_240111_rel3-joypad/bootloader/boards/arm/ats3085_dvb_watch_sdnand/Kconfig.board
```kconfig
# STM32F469I-DISCO board configuration

# Copyright (c) 2016 Linaro Limited.
# SPDX-License-Identifier: Apache-2.0

config BOARD_ATS3085_DVB_WATCH_SDNAND
	bool "ATS3085 dvb watch_sdnand Development Board"
	depends on SOC_LARK
```

## zs308a_240111_rel3-joypad/bootloader/boards/arm/ats3085c_dvb_watch_bootnand/Kconfig.board
```kconfig
# STM32F469I-DISCO board configuration

# Copyright (c) 2016 Linaro Limited.
# SPDX-License-Identifier: Apache-2.0

config BOARD_ATS3085C_DVB_WATCH_BOOTNAND
	bool "ATS3085C dvb watch BOOTNAND Development Board"
	depends on SOC_LARK
```

## zs308a_240111_rel3-joypad/bootloader/boards/arm/ats3085p_dvb_watch_ext_nor/Kconfig.board
```kconfig
# STM32F469I-DISCO board configuration

# Copyright (c) 2016 Linaro Limited.
# SPDX-License-Identifier: Apache-2.0

config BOARD_ATS3085P_DVB_WATCH_EXT_NOR
	bool "ATS3085P dvb watch no psram Development Board"
	depends on SOC_LARK
```

## zs308a_240111_rel3-joypad/bootloader/soc/arm/actions/lark/Kconfig.soc
```kconfig
# Copyright (c) 2016 Linaro Limited.
# SPDX-License-Identifier: Apache-2.0

choice
	prompt "LARK MCU Selection"
	depends on SOC_SERIES_LARK

config SOC_LARK
	bool "LARK"

endchoice

if SOC_LARK

config SOC_SPI0_USE_CK64M
	bool
	prompt "enable cpu spi0 to use CK64M clock source"
	default y
	help
		enable cpu spi0 to use CK64M clock source

config IRQ_VECTOR_IN_SRAM
	bool
	prompt "enable irq vector copy to sram"
	default n
	help
		enable irq vector copy to sram

config SLEEP_FUNC_IN_SRAM
	bool
	prompt "enable sleep func copy to sram"
	default y
	help
		enable sleep func copy to sram

config SOC_EP_MODE
	bool
	prompt "indicate ep mode"
	default n
	help
		prompt indicate ep mode

config SOC_SIGN_ENABLE
	bool
	prompt "signature verification eanble"
	default n
	help
		signature verification eanble


endif
```

## zs308a_240111_rel3-joypad/framework/display/Kconfig
```kconfig
# Kconfig - Actions system manager

#
# Copyright (c) 2016 Actions Corporation
#
# SPDX-License-Identifier: Apache-2.0
#

if ACTIONS_FRAMEWORK

menuconfig ACTIONS_FRAMEWORK_DISPLAY
	bool "Display Support"
	default y if UI_MANAGER || UI_MEMORY_MANAGER
	help
	  This option enables actions system manager.

config LED_MANAGER
	bool "LED Manager Support"
#	depends on LED
	help
	  This option enables actions led manager.

config SEG_LED_MANAGER
	bool "SEG LED Manager Support"
	depends on SEG_LED
	help
	  This option enables actions seg led  manager.

config UI_MANAGER
	bool "Ui Manager Support"
	help
	  This option enables actions app manager.

config UI_SERVICE
	bool "UI Service"
	depends on UI_MANAGER
	depends on UI_MEMORY_MANAGER
	select DISPLAY_COMPOSER
	help
	  This option enables actions UI service.

if UI_SERVICE

config UISRV_PRIORITY
	int "UI Service Thread Priority"
	default 3
	help
	  This option set ui service thread priority

config UISRV_STACKSIZE
	int "UI Service Thread Stack Size"
	default 2536
	help
	  This option set stack size for ui service thread

config UISRV_VIEW_PAUSED_SNAPSHOT
	bool "UI View Snapshot when Paused"
	help
	  This option take snapshot of view surface buffer when view paused,
	  When enabled, the surface buffer can be restored quickly when resumed.

config UISRV_KEY_EVENT_BYPASS
	bool "UI Input Key Event Bypass View"
	help
	  This option enables UI input key event bypass view, and sent directly
	  to foreground application.

config UI_INPUT_RECORDER
	bool "UI Input TP Event Recorder"
	help
	  This option enables UI input TP event recorder.

config UI_CUSTOM_GESTURE_DETECTION
	bool "UI Software Gesture Detection"
	help
	  This option enable software gesture detection, which will override the
	  tpkey hardware gesture value if exists.

config UI_VIEW_OVERLAY_OPA
	int "UI View Overlay Opacity"
	range 0 255
	default 128
	help
	  This option sets the blend opacity for the views' intersection area.
	  Set 255 to disable the blending.

choice
	prompt "View Scroll Buffer Mode"
	default VIEW_SCROLL_MEM_DEFAULT

config VIEW_SCROLL_MEM_DEFAULT
	bool "Scrolled View has Surface Buffer"

config VIEW_SCROLL_MEM_SAVE
	bool "Scrolled View has no Surface Buffer"

config VIEW_SCROLL_MEM_LOWEST
	bool "Scrolled View has no Surface Buffer and no Refresh"

endchoice

config VIEW_SCROLL_TRACKING_FINGER
	bool "UI View Scrolling Tracking Finger"
	default y
	help
	  This option enable view scrolling always tracking finger.

config VIEW_CACHE_LEVEL
	int "cache level for view cache"
	default 1
	help
	  This option set cache level for view cache

config VIEW_STACK_LEVEL
	int "maximum number of elements in view stack"
	default 5
	help
	  This option set maximum number of elements in view stack

config NUM_MSGBOX_POPUPS
	int "Maximum number of in-flight msgbox popups"
	default 3
	help
	  Set maximum number of in-flight msgbox popups.

endif # UI_SERVICE

choice
	prompt "Surface Buffer Swap Mode"
	default SURFACE_DOUBLE_BUFFER
	depends on UI_MEMORY_MANAGER

config SURFACE_DOUBLE_BUFFER
	bool "Double Buffer"

config SURFACE_SINGLE_BUFFER
	bool "Single Buffer"

endchoice

config RES_MANAGER
	bool "res_manager library"
	depends on UI_MEMORY_MANAGER
	help
	  This option enables the res_manager library.

if RES_MANAGER

config SIMPLE_RES_MANAGER
	bool "simple res_manager library"
	help
	  This option enables the simple res_manager library.

config RES_MANAGER_DISABLE_AUTO_SEARCH_FILES
	bool "disable auto search for updated res files"
	default y
	help
	  This option disables auto search for updated res files on incremental update

config RES_PRELOAD_MAX_BLOCK_SIZE
	int "max block size for res manager preload compact block"
	default 102400
	help
	  This option set max block size for res manager preload compact block
	  
config RES_MANAGER_ENABLE_MEM_LEAK_DEBUG
	bool "enable resource unload check in res manager"
	default n
	help
	  This option enables pic resource unload check in res manager

endif # RES_MANAGER

orsource "Kconfig.font"	  
orsource "Kconfig.lvgl"
rsource "memory/Kconfig"

endif # ACTIONS_FRAMEWORK
```
